## sht2xd/Kconfig
```kconfig
# SHT2xD temperature and humidity sensor configuration options

# Copyright (c) 2016 Intel Corporation
# SPDX-License-Identifier: Apache-2.0

menuconfig SHT2XD
	bool "SHT2xD Temperature and Humidity Sensor"
	depends on I2C
	help
	  Enable driver for SHT2xD temperature and humidity sensors.
```
